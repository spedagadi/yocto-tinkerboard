## sources/meta-rockchip/conf/machine/veyron-speedy.conf
```bitbake
# Copyright (C) 2015 Romain Perier
# Released under the MIT license (see COPYING.MIT for the terms)

#@TYPE: Machine
#@NAME: RK3288 Speedy
#@DESCRIPTION: Google Veyron Speedy Rev 1+ board (formally known as Chromebook Asus C201)
#https://www.google.com/chromebook/find/#?device=asus-chromebook-c201

include conf/machine/include/rk3288.inc
KERNEL_DEVICETREE = "rk3288-speedy.dtb"
MACHINE_EXTRA_RDEPENDS = "linux-firmware-bcm4354 linux-firmware-bcm-veyron kernel-module-brcmfmac kernel-module-cros-ec-accel kernel-module-btbcm kernel-module-hci-uart"
PREFERRED_PROVIDER_virtual/kernel = "linux-veyron"

XSERVER = " xserver-xorg \
	    xf86-video-armsoc-rockchip \
	    xf86-input-evdev \
	    xf86-input-synaptics \
	    xf86-input-keyboard"
```
