## build/conf/local.conf
```bitbake
LICENSE_FLAGS_WHITELIST = "commercial"
MACHINE ??= "tinker-rk3288"
DEFAULTTUNE = "cortexa17hf-neon-vfpv4"
DISTRO ?= 'rk-x11'
PACKAGE_CLASSES ?= 'package_deb'
EXTRA_IMAGE_FEATURES ?= "debug-tweaks"
USER_CLASSES ?= "buildstats image-mklibs image-prelink"
PATCHRESOLVE = "noop"
BB_DISKMON_DIRS = "\
    STOPTASKS,${TMPDIR},1G,100K \
    STOPTASKS,${DL_DIR},1G,100K \
    STOPTASKS,${SSTATE_DIR},1G,100K \
    STOPTASKS,/tmp,100M,100K \
    ABORT,${TMPDIR},100M,1K \
    ABORT,${DL_DIR},100M,1K \
    ABORT,${SSTATE_DIR},100M,1K \
    ABORT,/tmp,10M,1K"
PACKAGECONFIG_append_pn-qemu-native = " sdl"
PACKAGECONFIG_append_pn-nativesdk-qemu = " sdl"
CONF_VERSION = "1"

DL_DIR ?= "${BSPDIR}/downloads/"

IMAGE_INSTALL_append = " rockchip-mali"
BB_NUMBER_THREADS = '8'
PARALLEL_MAKE = '-j 12'

IMAGE_INSTALL_append += " gcc g++ binutils libgcc libgcc-dev libstdc++ libstdc++-dev libstdc++-staticdev \
autoconf automake ccache chkconfig glib-networking glibmm \
packagegroup-core-buildessential pkgconfig  \
boost cmake zlib glib-2.0 git gtk+ \
    gstreamer1.0 \
    gstreamer1.0-plugins-base \
    gstreamer1.0-plugins-good \
    gstreamer1.0-plugins-bad \
    gstreamer1.0-plugins-ugly \
    gstreamer1.0-dev \
    rockchip-mpp \
    gstreamer1.0-rockchip \
    openssh-sftp-server \
    cairo pango fontconfig freetype \
    live555 \
    v4l-utils \
    opencv \
    ffmpeg \
    nodejs \
    "

IMAGE_INSTALL_append += "kernel-modules"
```

## sources/base/conf/bblayers.conf
```bitbake
LCONF_VERSION = "6"

BBPATH = "${TOPDIR}"
BSPDIR := "${@os.path.abspath(os.path.dirname(d.getVar('FILE', True)) + '/../..')}"

BBFILES ?= ""
BBLAYERS = " \
  ${BSPDIR}/sources/poky/meta \
  ${BSPDIR}/sources/poky/meta-yocto \
  \
  ${BSPDIR}/sources/meta-openembedded/meta-oe \
  ${BSPDIR}/sources/meta-openembedded/meta-multimedia \
  ${BSPDIR}/sources/meta-openembedded/meta-filesystems \
  ${BSPDIR}/sources/meta-qt5 \
  \
  ${BSPDIR}/sources/meta-rockchip \
  ${BSPDIR}/sources/meta-rockchip-extra \
"
```

## sources/meta-kodi/conf/layer.conf
```bitbake
# We might have a conf and classes directory, append to BBPATH
BBPATH .= ":${LAYERDIR}"

# We have a recipes directory, add to BBFILES
BBFILES += "${LAYERDIR}/recipes*/*/*.bb ${LAYERDIR}/recipes*/*/*.bbappend"

BBFILE_COLLECTIONS += "meta-kodi"
BBFILE_PATTERN_meta-kodi := "^${LAYERDIR}/"
BBFILE_PRIORITY_meta-kodi = "8"
```

## sources/meta-rockchip-extra/conf/distro/include/rk-base.inc
```bitbake
require conf/distro/poky.conf

DISTRO = "rk-base"
DISTRO_NAME = "Rockchip Distro Base"
SDK_VENDOR = "-rksdk"

MAINTAINER = "Jacob Chen <jacob2.chen@rock-chips.com>"

TARGET_VENDOR = "-rk"

DISTROOVERRIDES = "rockchip"

# Rockchip BSP default settings

PREFERRED_VERSION_libdrm = "rk"
PREFERRED_VERSION_xserver-xorg = "rk"
PREFERRED_VERSION_xserver-nodm-init = "1.0"
XSERVER ?= "xserver-xorg \
		   xf86-input-libinput \
		   xf86-video-modesetting"

PREFERRED_PROVIDER_virtual/egl = "rockchip-mali"
PREFERRED_PROVIDER_virtual/libgles1 = "rockchip-mali"
PREFERRED_PROVIDER_virtual/libgles2 = "rockchip-mali"
PREFERRED_PROVIDER_virtual/libopencl = "rockchip-mali"

# Workaround: libmali.so provided by rk having no SONAME field in it
# so add it to fix rdepends problems
ASSUME_SHLIBS += "libEGL.so:rockchip-mali"
ASSUME_SHLIBS += "libGLESv1_CM.so:rockchip-mali"
ASSUME_SHLIBS += "libGLESv2.so:rockchip-mali"
ASSUME_SHLIBS += "libOpenCL.so:rockchip-mali"
ASSUME_SHLIBS += "libgbm.so:rockchip-mali"
ASSUME_SHLIBS += "libwayland-egl.so:rockchip-mali"

PREFERRED_PROVIDER_virtual/kernel = "linux-rockchip"

DEFAULTTUNE_rk3036="cortexa7hf-neon-vfpv4"
DEFAULTTUNE_rk3288="cortexa17hf-neon-vfpv4"
DEFAULTTUNE_rk3399="aarch64"
```

## sources/meta-rockchip-extra/conf/distro/rk-none.conf
```bitbake
require conf/distro/include/rk-base.inc

DISTRO = "rk-none"
DISTRO_NAME = "Rockchip no backend"

# Remove conflicting backends.
DISTRO_FEATURES_remove = "wayland x11"

DISTRO_FEATURES_append += " "
```

## sources/meta-rockchip-extra/conf/distro/rk-wayland.conf
```bitbake
require conf/distro/include/rk-base.inc

DISTRO = "rk-wayland"
DISTRO_NAME = "Rockchip Wayland"

# Remove conflicting backends.
DISTRO_FEATURES_remove = "x11"

# These are wayland specific
DISTRO_FEATURES_append += " wayland"
```

## sources/meta-rockchip-extra/conf/distro/rk-x11.conf
```bitbake
require conf/distro/include/rk-base.inc

DISTRO = "rk-x11"
DISTRO_NAME = "Rockchip X11"

# Remove conflicting backends.
DISTRO_FEATURES_remove = "wayland "

# These are X11 specific
DISTRO_FEATURES_append += " x11"
```

## sources/meta-rockchip-extra/conf/layer.conf
```bitbake
# Copyright (C) 2017 Fuzhou Rockchip Electronics Co., Ltd
# Released under the MIT license (see COPYING.MIT for the terms)

# We have a conf and classes directory, add to BBPATH
BBPATH .= ":${LAYERDIR}"

# We have recipes-* directories, add to BBFILES
BBFILES += "${LAYERDIR}/recipes-*/*/*.bb ${LAYERDIR}/recipes-*/*/*.bbappend"

BBFILE_COLLECTIONS += "rockchip_extra"
BBFILE_PATTERN_rockchip_extra = "^${LAYERDIR}/"
BBFILE_PRIORITY_rockchip_extra = "1"

# This should only be incremented on significant changes that will
# cause compatibility issues with other layers
LAYERVERSION_rockchip_extra = "1"

LAYERDEPENDS_rockchip_extra = "core"
LICENSE_PATH += "${LAYERDIR}/licenses"
```

## sources/meta-rockchip/conf/layer.conf
```bitbake
# Copyright (C) 2014 NEO-Technologies
# Released under the MIT license (see COPYING.MIT for the terms)

# We have a conf and classes directory, add to BBPATH
BBPATH .= ":${LAYERDIR}"

# We have recipes-* directories, add to BBFILES
BBFILES += "${LAYERDIR}/recipes-*/*/*.bb ${LAYERDIR}/recipes-*/*/*.bbappend"

BBFILE_COLLECTIONS += "rockchip"
BBFILE_PATTERN_rockchip = "^${LAYERDIR}/"
BBFILE_PRIORITY_rockchip = "1"

# This should only be incremented on significant changes that will
# cause compatibility issues with other layers
LAYERVERSION_rockchip = "1"

LAYERDEPENDS_rockchip = "core"
LICENSE_PATH += "${LAYERDIR}/licenses"
```

## sources/meta-rockchip/conf/machine/evb-rk3288.conf
```bitbake
# Copyright (C) 2017 Fuzhou Rockchip Electronics Co., Ltd
# Released under the MIT license (see COPYING.MIT for the terms)

#@TYPE: Machine
#@NAME: EVB 3288

include conf/machine/include/rk3288.inc

KERNEL_DEVICETREE = "rk3288-evb-act8846.dtb"
UBOOT_MACHINE = "evb-rk3288_defconfig"
```

## sources/meta-rockchip/conf/machine/evb-rv1108.conf
```bitbake
# Copyright (C) 2017 Fuzhou Rockchip Electronics Co., Ltd
# Released under the MIT license (see COPYING.MIT for the terms)

#@TYPE: Machine
#@NAME: EVB rv1108

include conf/machine/include/rv1108.inc

KERNEL_DEVICETREE = "rv1108-evb.dtb"
UBOOT_MACHINE = "evb-rk3288_defconfig"
```

## sources/meta-rockchip/conf/machine/excavator-rk3399.conf
```bitbake
# Copyright (C) 2017 Fuzhou Rockchip Electronics Co., Ltd
# Released under the MIT license (see COPYING.MIT for the terms)

#@TYPE: Machine
#@NAME: EXCAVATOR 3399

include conf/machine/include/rk3399.inc

KERNEL_DEVICETREE = "rockchip/rk3399-sapphire-excavator-linux.dtb"
UBOOT_MACHINE = "evb-rk3399_defconfig"

GPTIMG_APPEND = "console=tty1 console=ttyFIQ0,1500000n8 rw root=/dev/mmcblk1p7 rootfstype=ext4 init=/sbin/init"
```

## sources/meta-rockchip/conf/machine/fennec-rk3288.conf
```bitbake
# Copyright (C) 2017 Fuzhou Rockchip Electronics Co., Ltd
# Released under the MIT license (see COPYING.MIT for the terms)

#@TYPE: Machine
#@NAME: FENNEC RK3288

include conf/machine/include/rk3288.inc

KERNEL_DEVICETREE = "rk3288-fennec.dtb"
UBOOT_MACHINE = "fennec-rk3288_defconfig"
```

## sources/meta-rockchip/conf/machine/firefly-rk3288.conf
```bitbake
# Copyright (C) 2015 Romain Perier
# Released under the MIT license (see COPYING.MIT for the terms)

#@TYPE: Machine
#@NAME: Firefly RK3288
#@DESCRIPTION: Firefly-RK3288 is a high-performance platform, with strong computing power, graphic processing and video decoding ability.
#http://www.t-firefly.com/en/

include conf/machine/include/rk3288.inc

KERNEL_DEVICETREE = "rk3288-firefly.dtb"
UBOOT_MACHINE = "firefly-rk3288_defconfig"
```

## sources/meta-rockchip/conf/machine/include/rk3036.inc
```bitbake
# Copyright (C) 2017 Jacob Chen
# Released under the MIT license (see COPYING.MIT for the terms)

SOC_FAMILY = "rk3036"

require conf/machine/include/tune-cortexa7.inc
require conf/machine/include/soc-family.inc

PREFERRED_PROVIDER_virtual/kernel = "linux"
SERIAL_CONSOLES = "115200;ttyS2"
KERNEL_IMAGETYPE = "zImage"
KBUILD_DEFCONFIG = "multi_v7_defconfig"

PREFERRED_PROVIDER_virtual/bootloader ?= "u-boot-rockchip"
SPL_BINARY ?= "u-boot-spl-nodtb.bin"

IMAGE_FSTYPES = "ext4 rockchip-gpt-img"
IMAGE_CLASSES += "rockchip-gpt-img"

GPTIMG_APPEND = "console=tty1 console=ttyS2,115200n8 rw root=/dev/mmcblk1p7 rootfstype=ext4 init=/sbin/init rootwait"
```

## sources/meta-rockchip/conf/machine/include/rk3066.inc
```bitbake
# Copyright (C) 2014 NEO-Technologies
# Released under the MIT license (see COPYING.MIT for the terms)

SOC_FAMILY = "rk3066"

require conf/machine/include/tune-cortexa9.inc
require conf/machine/include/soc-family.inc

PREFERRED_PROVIDER_virtual/xserver = "xserver-xorg"

XSERVER = "xserver-xorg \
           xf86-video-fbturbo \
           xf86-input-evdev \
           xf86-input-mouse \
           xf86-input-keyboard"

PREFERRED_PROVIDER_virtual/kernel = "linux-rockchip-3.0"

KERNEL_IMAGETYPE = "zImage"

IMAGE_FSTYPES += "ext4"

SERIAL_CONSOLES ?= "115200;ttyFIQ0"
KBUILD_DEFCONFIG = "multi_v7_defconfig"
```

## sources/meta-rockchip/conf/machine/include/rk3188.inc
```bitbake
# Copyright (C) 2015 Romain Perier
# Released under the MIT license (see COPYING.MIT for the terms)

SOC_FAMILY  = "rk3188"

require conf/machine/include/tune-cortexa9.inc
require conf/machine/include/soc-family.inc
PREFERRED_PROVIDER_virtual/xserver = "xserver-xorg"

XSERVER = "xserver-xorg \
           xf86-video-fbturbo \
           xf86-input-evdev \
           xf86-input-mouse \
           xf86-input-keyboard"

PREFERRED_PROVIDER_virtual/kernel = "linux-rockchip-3.0"

KERNEL_IMAGETYPE = "zImage"

IMAGE_FSTYPES += "ext4"

SERIAL_CONSOLES ?= "115200;ttyFIQ0"
KBUILD_DEFCONFIG = "multi_v7_defconfig"
```

## sources/meta-rockchip/conf/machine/include/rk3288.inc
```bitbake
# Copyright (C) 2015 Romain Perier
# Released under the MIT license (see COPYING.MIT for the terms)

SOC_FAMILY = "rk3288"

require conf/machine/include/tune-cortexa17.inc
require conf/machine/include/soc-family.inc

PREFERRED_PROVIDER_virtual/kernel ?= "linux"
SERIAL_CONSOLES = "115200;ttyS2"
KERNEL_IMAGETYPE = "zImage"
KBUILD_DEFCONFIG = "multi_v7_defconfig"

PREFERRED_PROVIDER_virtual/bootloader ?= "u-boot-rockchip"
SPL_BINARY ?= "u-boot-spl-dtb.bin"

IMAGE_FSTYPES = "ext4 rockchip-gpt-img"
IMAGE_CLASSES += "rockchip-gpt-img"
```

## sources/meta-rockchip/conf/machine/include/rk3399.inc
```bitbake
# Copyright (C) 2017 Jacob Chen
# Released under the MIT license (see COPYING.MIT for the terms)

SOC_FAMILY = "rk3399"

require conf/machine/include/arm/arch-armv8.inc
require conf/machine/include/soc-family.inc

PREFERRED_PROVIDER_virtual/kernel = "linux"
SERIAL_CONSOLES = "1500000;ttyS2"
KERNEL_IMAGETYPE = "Image"
KBUILD_DEFCONFIG = "multi_v8_defconfig"

PREFERRED_PROVIDER_virtual/bootloader ?= "u-boot-rockchip"
SPL_BINARY ?= "u-boot-spl-nodtb.bin"

IMAGE_FSTYPES = "ext4 rockchip-gpt-img"
IMAGE_CLASSES += "rockchip-gpt-img"
```

## sources/meta-rockchip/conf/machine/include/rv1108.inc
```bitbake
# Copyright (C) 2017 Fuzhou Rockchip Electronics Co., Ltd
# Released under the MIT license (see COPYING.MIT for the terms)

SOC_FAMILY = "rv1108"

require conf/machine/include/tune-cortexa7.inc
require conf/machine/include/soc-family.inc

PREFERRED_PROVIDER_virtual/kernel = "linux"
SERIAL_CONSOLES = "1500000;ttyS2"
KERNEL_IMAGETYPE = "zImage"
KBUILD_DEFCONFIG = "multi_v7_defconfig"
```

## sources/meta-rockchip/conf/machine/kylin-rk3036.conf
```bitbake
# Copyright (C) 2017 Fuzhou Rockchip Electronics Co., Ltd
# Released under the MIT license (see COPYING.MIT for the terms)

#@TYPE: Machine
#@NAME: Kylin rk3036

include conf/machine/include/rk3036.inc

KERNEL_DEVICETREE = "rk3036-kylin.dtb"
UBOOT_MACHINE = "kylin-rk3036_defconfig"
```

## sources/meta-rockchip/conf/machine/marsboard-rk3066.conf
```bitbake
# Copyright (C) 2015 Romain Perier
# Released under the MIT license (see COPYING.MIT for the terms)

#@TYPE: Machine
#@NAME: MarsBoard RK3066 Board
#@DESCRIPTION: The Marsboard-RK3066 is powered by the popular Rockchip dual core SOC combining a power dual core ARM Cortex A9 CPU and Quad core Mali400MP4 GPU.
#http://www.marsboard.com

require conf/machine/include/rk3066.inc

PREFERRED_PROVIDER_virtual/kernel = "linux"
SERIAL_CONSOLES = "115200;ttyS2"
KERNEL_DEVICETREE = "rk3066a-marsboard.dtb"
```

## sources/meta-rockchip/conf/machine/radxarock.conf
```bitbake
# Copyright (C) 2014 NEO-Technologies
# Copyright (C) 2015 Romain Perier
# Released under the MIT license (see COPYING.MIT for the terms)

#@TYPE: Machine
#@NAME: Radxa Rock Board
#@DESCRIPTION: Radxa Rock is SBC designed by Radxa.It has quad-core ARM cortex-a9 processor, 80 pin headers, which makes easy to connect other I/O or GPIO
#http://radxa.com

require conf/machine/include/rk3188.inc

PREFERRED_PROVIDER_virtual/kernel ?= "linux-rockchip"
SERIAL_CONSOLES ?= "115200;ttyFIQ0"
KERNEL_DEVICETREE ?= "rk3188-radxarock.dtb"
OLDEST_KERNEL ?= "3.0"
```

## sources/meta-rockchip/conf/machine/rock2-square.conf
```bitbake
# Copyright (C) 2016 Romain Perier
# Released under the MIT license (see COPYING.MIT for the terms)

#@TYPE: Machine
#@NAME: Rock2 Square
#@DESCRIPTION: Radxa Rock2 is a series of the second single board computer from Radxa. This is the square baseboard.
#http://radxa.com/Rock2

include conf/machine/include/rk3288.inc
KERNEL_DEVICETREE = "rk3288-rock2-square.dtb"
```

## sources/meta-rockchip/conf/machine/tinker-rk3288.conf
```bitbake
# Copyright (C) 2017 Fuzhou Rockchip Electronics Co., Ltd
# Released under the MIT license (see COPYING.MIT for the terms)

#@TYPE: Machine
#@NAME: Tinker RK3288
#@DESCRIPTION: ASUS Tinker Board is a Raspberry Pi 3 Alternative based on Rockchip RK3288 Processor.

include conf/machine/include/rk3288.inc

KERNEL_DEVICETREE = "rk3288-miniarm.dtb"
UBOOT_MACHINE = "tinker-rk3288_defconfig"

#MACHINE_EXTRA_RRECOMMENDS = "kernel-module-r8723bs rtl8723bs"

GPTIMG_APPEND = "console=tty1 console=ttyS2,115200n8 rw root=/dev/mmcblk0p7 rootfstype=ext4 init=/sbin/init"
```
